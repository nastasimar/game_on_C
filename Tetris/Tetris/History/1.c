#include <MDR32Fx.h>
#include "lcd.h"

#define primitivSize	5

#define mapWidth		primitivSize*10
#define mapHeight		primitivSize*20

#define objWidth		5	
#define objHeight		1	

#define ScreenHeight	128
#define ScreenWidth		64

uint8_t StaticFigures[mapHeight][mapWidth];
uint8_t MovingFigures[mapHeight][mapWidth];

int testObj[objWidth][objHeight] = {
	0x1f, 
  0x1f, 
  0x1f, 
  0x1d, 
  0x1f};

	
	
typedef struct{
	uint8_t x, y;
} Object;

Object cube;



void SetObjectPos(Object *obj, uint8_t x, uint8_t y){
	(*obj).x = x;
	(*obj).y = y;
}

void ShowObj(uint8_t xPos, uint8_t yPos, Object obj){
	uint8_t page;
	uint8_t crystal = 0;
	uint8_t byte = 0;
	uint8_t bitPos = 0;
	int y = (y > 63) ? (127 - y) : (63 - y);
	int x = xPos;
//	for(int y = yPos; y < (yPos + objHeight); y++){
//		for(int x = xPos; x < (xPos + (objWidth * 8)); x+=8){
			if(yPos < 63) crystal = 1;
			page = (7 - (x / 8));
			SetAddr(y, crystal);
			SetPage(page, crystal);	
			
			SetAddr(y, crystal);
			byte |= (testObj[y][x] >> (x % 8));
			Send_Data(byte, crystal);
			page++;
			SetPage(page, crystal);	
			byte = (testObj[y - yPos][x - xPos] << (7 - (x % 8)));
			x+=8;
			y++;
			SetAddr(y, crystal);
			byte |= (testObj[y][x] >> (x % 8));
			Send_Data(byte, crystal);
	
			SetAddr(y, crystal);
			byte |= (testObj[y][x] >> (x % 8));
			Send_Data(byte, crystal);
			page++;
						SetPage(page, crystal);
			byte = (testObj[y - yPos][x - xPos] << (7 - (x % 8)));
			x+=8;
			y++;
			SetAddr(y, crystal);
			byte |= (testObj[y][x] >> (x % 8));
			Send_Data(byte, crystal);
			
			SetAddr(y, crystal);
			byte |= (testObj[y][x] >> (x % 8));
			Send_Data(byte, crystal);
			page++;
						SetPage(page, crystal);
			byte = (testObj[y - yPos][x - xPos] << (7 - (x % 8)));
			x+=8;
			y++;
			SetAddr(y, crystal);
			byte |= (testObj[y][x] >> (x % 8));
			Send_Data(byte, crystal);
			

	
}

char screen[ScreenHeight][ScreenWidth];

void ScreenUpdate(char ** array){
	char byte = 0;
	char x = ScreenWidth;
	char y = ScreenHeight;
	for(char crystal = 0; crystal < 2; crystal++){
		for(char page = 0; page < 8; page++){
			for(char height = 0; height < 64; height++){
				for(char bit = 0; bit < 8; bit++){
					byte |= (array[y - (crystal * 64) - bit][x - (page * 8) - bit] << bit);	
}

int main(void)
{
	initPerefirial();
	InitLcd();
	SetPage(0, 0);
	SetAddr(0, 0);

		uint8_t pic[] = {  0x1f, 
  0x1f, 
  0x1f, 
  0x1d, 
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0x00, 0x00, 0x80, 0x00, 0x00, 0x00, 0x00, 0x00, 0x00, 0x00, 0x00, 0x00, 0x00, 0x00, 0x00, 0x00};
		
		//load_pic(pic);
	SetPage(0, 0);
	SetAddr(0, 0);
	clear_lcd();
	SetPage(0, 0);
	SetAddr(1, 0);
	//Send_Data(0xFF,0);
	ShowObj(1, 1, cube);
	while(1);
}